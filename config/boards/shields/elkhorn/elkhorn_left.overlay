/*
 * Copyright (c) 2020 Pete Johanson
 *
 * SPDX-License-Identifier: MIT
 */

 /*
-elkhead v2 gpio-
P0.15 = R1
P0.17 = R2
P0.11 = R3
P1.09 = R4
P0.20 = C1
P0.04 = C2
P0.31 = C3
P0.30 = C4
P0.29 = C5
P0.28 = C6
P0.02 = C7
P0.03 = C8
 */

#include "elkhorn.dtsi"


&kscan0 {
    col-gpios
        = <&gpio0 20 GPIO_ACTIVE_HIGH>
        , <&gpio0 4 GPIO_ACTIVE_HIGH>
        , <&gpio0 31 GPIO_ACTIVE_HIGH>
        , <&gpio0 30 GPIO_ACTIVE_HIGH>
        , <&gpio0 29 GPIO_ACTIVE_HIGH>
        , <&gpio0 28 GPIO_ACTIVE_HIGH>
        , <&gpio0 2 GPIO_ACTIVE_HIGH>
        , <&gpio0 3 GPIO_ACTIVE_HIGH>
        ;
};
