## boards/arm/split_heart/Kconfig.board
```kconfig
config BOARD_SPLIT_HEART_LEFT
    bool "Split Heart left"
    depends on SOC_NRF52840_QIAA

config BOARD_SPLIT_HEART_RIGHT
    bool "Split Heart right"
    depends on SOC_NRF52840_QIAA
```

## config/boards/arm/elkhead/Kconfig
```kconfig
config BOARD_ENABLE_DCDC
    bool "Enable DCDC mode"
    select SOC_DCDC_NRF52X
    default n
    depends on (BOARD_ELKHEAD_11 || BOARD_ELKHEAD_11_FLIPPED || BOARD_ELKHEAD_13 || BOARD_ELKHEAD_13_52833)

config BOARD_ELKHEAD_CHARGER
    bool "Enable battery charger"
    default n
    depends on (BOARD_ELKHEAD_13 || BOARD_ELKHEAD_13_52833)
```

## config/boards/arm/elkhead/Kconfig.board
```kconfig
# elkhead board configuration

# Copyright (c) 2020 The ZMK Contributors
# SPDX-License-Identifier: MIT

config BOARD_ELKHEAD_13_52833
    bool "elkhead_13_52833"
    depends on SOC_NRF52833_QIAA
```

## config/boards/arm/elkhead/Kconfig.defconfig
```kconfig
# Electronut Labs Papyr board configuration

# Copyright (c) 2020 The ZMK Contributors
# SPDX-License-Identifier: MIT

if BOARD_ELKHEAD_13_52833

config BOARD
    default "elkhead"

config BT_CTLR
    default BT

config ZMK_BLE
    default y

config ZMK_USB
    default y

config PINMUX
    default y

if BOARD_ELKHEAD_13_52833


endif # BOARD_ELKHEAD_13_52833

endif # BOARD_ELKHEAD_11 || BOARD_ELKHEAD_11_FLIPPED || BOARD_ELKHEAD_13 || BOARD_ELKHEAD_13_52833
```

## config/boards/arm/nrfbig/Kconfig
```kconfig
config BOARD_ENABLE_DCDC
    bool "Enable DCDC mode"
    select SOC_DCDC_NRF52X
    default y
    depends on (BOARD_NRFBIG_11 || BOARD_NRFBIG_11_FLIPPED || BOARD_NRFBIG_13 || BOARD_NRFBIG_13_52833)

config BOARD_NRFBIG_CHARGER
    bool "Enable battery charger"
    default y
    depends on (BOARD_NRFBIG_13 || BOARD_NRFBIG_13_52833)
```

## config/boards/arm/nrfbig/Kconfig.board
```kconfig
# nrfbig board configuration

# Copyright (c) 2020 The ZMK Contributors
# SPDX-License-Identifier: MIT

config BOARD_NRFBIG_11
    bool "nrfbig_11"
    depends on SOC_NRF52840_QIAA

config BOARD_NRFBIG_11_FLIPPED
    bool "nrfbig_11_flipped"
    depends on SOC_NRF52840_QIAA

config BOARD_NRFBIG_13
    bool "nrfbig_13"
    depends on SOC_NRF52840_QIAA

config BOARD_NRFBIG_13_52833
    bool "nrfbig_13_52833"
    depends on SOC_NRF52833_QIAA
```

## config/boards/arm/nrfbig/Kconfig.defconfig
```kconfig
# Electronut Labs Papyr board configuration

# Copyright (c) 2020 The ZMK Contributors
# SPDX-License-Identifier: MIT

if BOARD_NRFBIG_11 || BOARD_NRFBIG_11_FLIPPED || BOARD_NRFBIG_13 || BOARD_NRFBIG_13_52833

config BOARD
    default "nrfbig"

if USB_DEVICE_STACK

config USB_NRFX
    default y

endif # USB_DEVICE_STACK

config BT_CTLR
    default BT

config ZMK_BLE
    default y

config ZMK_USB
    default y

config PINMUX
    default y

if BOARD_NRFBIG_13 || BOARD_NRFBIG_13_52833

config BOARD_NRFBIG_CHARGER
    default y

endif # BOARD_NRFBIG_13 || BOARD_NRFBIG_13_52833

endif # BOARD_NRFBIG_11 || BOARD_NRFBIG_11_FLIPPED || BOARD_NRFBIG_13 || BOARD_NRFBIG_13_52833
```

## config/boards/shields/elkhorn/Kconfig.defconfig
```kconfig
if SHIELD_ELKHORN_LEFT

config ZMK_KEYBOARD_NAME
    default "Elkhorn"

config ZMK_SPLIT_ROLE_CENTRAL
    default y

endif

if SHIELD_ELKHORN_LEFT || SHIELD_ELKHORN_RIGHT

config ZMK_SPLIT
    default y

endif
```

## config/boards/shields/elkhorn/Kconfig.shield
```kconfig
# Copyright (c) 2020 Pete Johanson
# SPDX-License-Identifier: MIT

config SHIELD_ELKHORN_LEFT
    def_bool $(shields_list_contains,elkhorn_left)

config SHIELD_ELKHORN_RIGHT
    def_bool $(shields_list_contains,elkhorn_right)
```

## config/west.yml
```yaml
manifest:
  remotes:
    - name: zmkfirmware
      #url-base: https://github.com/ftc/     # <--- CHANGE REPO
      url-base: https://github.com/zmkfirmware
  projects:
    - name: zmk
      remote: zmkfirmware
      #revision: mouse-ftc                   # <--- CHANGE REVISION
      revision: main
      import: app/west.yml
  self:
    path: config
```
